&i2c0 {
    status = "okay";
    clock-frequency = <I2C_BITRATE_FAST>;

    mcp_io: mcp23017@20 {
        compatible = "microchip,mcp230xx";
        status = "okay";
        gpio-controller;
        reg = <0x20>;
        #gpio-cells = <2>;
        ngpios = <16>;
        int-gpios = <&xiao_d 0 GPIO_ACTIVE_LOW>;
    };
};